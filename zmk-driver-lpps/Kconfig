## zmk-driver-lpps/Kconfig
```kconfig
menuconfig LPPS
    bool "low power pointing stick"
    select I2C
    help
      Enable LPPS

if LPPS

config LPPS_JITTER_FILTER
    bool "LPPS software jitter filter"
    default y
    help
      When disabled, each motion IRQ reports raw x/y deltas (same as the upstream
      sekigon-gonnoc driver). Use this for drift/jitter baseline testing.
      When enabled, burst/streak/accum thresholds gate small noise before reporting.

if LPPS_JITTER_FILTER

config LPPS_ACCUM_REPORT
    int "Accumulated delta before a relative motion report"
    default 8
    range 1 127
    help
      Sum of per-IRQ x/y deltas (per axis) must reach at least this magnitude
      before a report is sent, unless INSTANT_REPORT triggers.

config LPPS_INSTANT_REPORT
    int "Single-sample magnitude for immediate report"
    default 12
    range 1 127
    help
      One IRQ sample at or above this value on an axis bypasses accumulation.

config LPPS_ACCUM_IDLE_MS
    int "Reset accumulators after this many idle milliseconds"
    default 40
    range 1 1000
    help
      If no motion IRQ occurs for this long, accumulated x/y noise is cleared.

endif

endif
```

## zmk-driver-lpps/dts/bindings/behaviors/zmk,behavior-trackpoint-control.yaml
```yaml
description: TrackPoint Control (keymap metadata for LTP/RTP panel slots)

compatible: "zmk,behavior-trackpoint-control"

include: one_param.yaml
```

## zmk-driver-lpps/dts/bindings/behaviors/zmk,behavior-trackpoint-layer-led.yaml
```yaml
description: Solid RGB LED for auto TrackPoint layer (split peripheral sync)

compatible: "zmk,behavior-trackpoint-layer-led"

include: one_param.yaml
```

## zmk-driver-lpps/dts/bindings/zmk,behavior-lpps-set-accum.yaml
```yaml
description: Set LPPS runtime accumulation threshold on this keyboard half

compatible: "zmk,behavior-lpps-set-accum"

include: one_param.yaml
```

## zmk-driver-lpps/dts/bindings/zmk,behavior-tp-left-ctl.yaml
```yaml
description: Central TrackPoint control (0=toggle, 1/2=left N±, 3/4=right N±)

compatible: "zmk,behavior-tp-left-ctl"

include: one_param.yaml
```

## zmk-driver-lpps/dts/bindings/zmk,input-processor-left-tp-gate.yaml
```yaml
description: Drop left split TrackPoint relative events when disabled on central

compatible: "zmk,input-processor-left-tp-gate"

include: ip_zero_param.yaml
```

## zmk-driver-lpps/dts/bindings/zmk,input-processor-tp-layer.yaml
```yaml
description: Temporary TrackPoint layer input processor with net-displacement and multi-frame activation guard

compatible: "zmk,input-processor-tp-layer"

include: ip_two_param.yaml

properties:
  activation-threshold:
    type: int
    required: false
    default: 24
    description: Net displacement |sum(dx)| + |sum(dy)| within activation-window-ms required before enabling the layer

  min-activation-frames:
    type: int
    required: false
    default: 2
    description: Minimum consecutive sync frames with X/Y motion required before enabling the layer

  activation-window-ms:
    type: int
    required: false
    default: 250
    description: Sliding idle window in ms before resetting pre-activation motion tracking

  require-prior-idle-ms:
    type: int
    required: false
    default: 250
    description: Time in ms after a non-modifier keystroke before the layer may activate

  excluded-positions:
    type: array
    required: false
    default: []
    description: Key positions (e.g. mouse button thumbs) that keep the temporary layer active when pressed
```

## zmk-driver-lpps/dts/bindings/zmk,input-processor-tpc-mode.yaml
```yaml
description: Applies LTP/RTP mode (move vs scroll) to TrackPoint REL events

compatible: "zmk,input-processor-tpc-mode"

include: ip_one_param.yaml
```

## zmk-driver-lpps/dts/bindings/zmk,input-processor-typing-lockout.yaml
```yaml
description: Suppress relative pointer events briefly after non-modifier keystrokes (param1 = lockout ms)

compatible: "zmk,input-processor-typing-lockout"

include: ip_one_param.yaml
```
